## chu-overlay/buildroot/package/dmenu/Config.in
```kconfig
config BR2_PACKAGE_DMENU
	bool "dmenu"
	depends on BR2_PACKAGE_XORG7
	select BR2_PACKAGE_XLIB_LIBX11
	select BR2_PACKAGE_XLIB_LIBXFT
	help
	  Dynamic Menu (dmenu)

	  https://tools.suckless.org/dmenu/
```

## chu-overlay/buildroot/package/dwm/Config.in
```kconfig
config BR2_PACKAGE_DWM
	bool "dwm"
	help
	  Dynamic Window Manager (dwm)

	  https://dwm.suckless.org/
```

## chu-overlay/buildroot/package/dwmblocks/Config.in
```kconfig
config BR2_PACKAGE_DWMBLOCKS
	bool "dwmblocks"
	depends on BR2_PACKAGE_XORG7
	select BR2_PACKAGE_XLIB_LIBX11
	select BR2_PACKAGE_XLIB_LIBXFT
	help
	  https://github.com/LukeSmithxyz/dwmblocks
```

## chu-overlay/buildroot/package/ubuntu-fonts/Config.in
```kconfig
config BR2_PACKAGE_UBUNTU_FONTS
	bool "Ubuntu Fonts"
	help
	  Ubuntu Sans Mono Fonts

	  https://github.com/canonical/Ubuntu-Sans-Mono-fonts
```
